## firmware/fancyfeast/src/Kconfig
```kconfig
config LED_RGB_HEIGHT
	int "Number of RGB LEDs High"
	default 9
	help
	  Number of RGB LEDs high to use

config LED_RGB_WIDTH
	int "Number of RGB LEDs Wide"
	default 13
	help
	  Number of RGB LEDs wide to use

config LED_BRIGHTNESS_DEFAULT
	int "Default LED brightness, can be overriden by user settings"
	default 25
	help
		The default value to use for LED brightness in the event the user has not overriden it

config CRON_JERB_INTERVAL
	int "Number of milliseconds between cron jerbs"
	default 60000
	range 60000 3600000
	help
		Number of milliseconds between cron jerbs	

config ANDNXOR_SHELL_PROMPT
	string "The prompt to show for the shell"
	default "and!xor $ "
	help
		The prompt to show for the shell

config ANDNXOR_SHELL_ROOT_PROMPT
	string "The prompt to show for the root shell"
	default "and!xor # "
	help
		The prompt to show for the root shell

config ANDNXOR_UI_INTERSTITIAL_TIME_MS
	int "How long to show interstitial when switching menu items in ms"
	default 2000
	range 100 10000
	help
		"How long to show interstitial when switching menu items in ms"

config ANDNXOR_TEST_FIRMWARE
	bool "Build test firmware for use in production"
	default n
	help
		"Build test firmware for use in production"
```

## firmware/fancyfeast/src/drivers/Kconfig
```kconfig
rsource "at24c02.kconfig"
rsource "iqs333.kconfig"
rsource "spi_nor_reset.kconfig"

menuconfig IS31FL3741
	bool "IS31FL3741 LED Matrix driver"
	help
		Include LED Matrix Driver

if IS31FL3741

config IS31FL3741_DEV_NAME
	string "IS31FL3741 device name"
	default "IS31FL3741"
	help
	  Device name for IS31FL3741 LED Matrix driver.

config IS31FL3741_I2C_ADDRESS
	hex "IS31FL3741 I2C slave address"
	range 0x30 0x33
	default 0x30
	help
	  Specify the I2C slave address for the IS31FL3741 LED driver.
	  See Datasheet "Table 1 Slave Address"

config IS31FL3741_SDB_PIN
	int "IS31FL3741 SDB Pin Number"
	range 0 64
	default 18
	help 
		Specify the GPIO pin number of the SDB Pin

config IS31FL3741_INTB_PIN
	int "IS31FL3741 INTB Pin Number"
	range 0 64
	default 30
	help 
		Specify the GPIO pin number of the INTB Pin

config IS31FL3741_INIT_PRIORITY
	int "IS31FL3741 Initialization Priority"
	range 61 100
	default 90
	help
		System Initialization priority for IS31FL3741 driver

config IS31FL3741_I2C_MASTER_DEV_NAME
	string "I2C master where IS31FL3741 is connected"
	default "I2C_0"
	help
	  Specify the device name of the I2C master device to which
	  IS31FL3741 is connected.

endif
```

## firmware/fancyfeast/src/mesh/Kconfig
```kconfig
config MESH_STATUS_PUBLISH_INTERVAL
	int "Number of milliseconds between status publishing"
	default 90000
	range 10000 600000
	help
		Number of milliseconds between status publishing

config ANDNXOR_SHELL_TTL
	int "Maximum hops for shell commands"
	default 4
	range 1 6
	help
		"How many hops (TTL) are allowed for shell commands"

config MESH_BLING_PUBLISH_INTERVAL
	int "Number of milliseconds between bling publishing"
	default 60000
	range 10000 600000
	help
		Number of milliseconds between bling publishing

config ANDNXOR_BLING_TTL
	int "Maximum hops for bling state sharing"
	default 0
	range 0 6
	help
		"How many hops (TTL) are allowed for bling state sharing"

config ANDNXOR_C2_RUNTIME_MS
	int "How long should C2 bling modes run"
	default 60000
	range 1000 360000
	help
		"How long should C2 bling modes run"

config ANDNXOR_C2_TTL
	int "Maximum hops for C2 messages"
	default 5
	range 0 6
	help
		"How many hops (TTL) are allowed for C2 messages"

config ANDNXOR_SOCIAL_TTL
	int "Maximum hops for social sync"
	default 2
	range 0 6
	help
		"How many hops (TTL) are allowed for social sync"

config ANDNXOR_TIME_TTL
	int "Maximum hops for time sync"
	default 6
	range 1 8
	help
		"How many hops (TTL) are allowed for time sync"
```
